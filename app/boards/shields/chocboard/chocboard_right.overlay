#include "chocboard.dtsi" // Notice that the main dtsi files are included in the overlay.

nice_view_spi: &spi0 {
	compatible = "nordic,nrf-spim";
	sck-pin = <17>;
	mosi-pin = <8>;
    miso-pin = <9>;
	cs-gpios = <&pro_micro 1 GPIO_ACTIVE_HIGH>;
};

&default_transform { // The matrix transform for this board is 6 columns over because the left half is 6 columns wide according to the matrix.
    col-offset = <6>;
};
&kscan0 {
    col-gpios
        = <&pro_micro 16 GPIO_ACTIVE_HIGH> // col1 in the schematic
        , <&pro_micro 14 GPIO_ACTIVE_HIGH> // col2 in the schematic
        , <&pro_micro 15 GPIO_ACTIVE_HIGH> // col3 in the schematic
        , <&pro_micro 18 GPIO_ACTIVE_HIGH> // col4 in the schematic
        , <&pro_micro 19 GPIO_ACTIVE_HIGH> // col5 in the schematic
        , <&pro_micro 20 GPIO_ACTIVE_HIGH> // col6 in the schematic
        ;
};