## app/boards/shields/c4/Kconfig.defconfig
```kconfig
if SHIELD_C4_RIGHT

config ZMK_KEYBOARD_NAME
    default "compression 4c"

config ZMK_SPLIT_ROLE_CENTRAL
    default y

endif

config ZMK_IDLE_TIMEOUT
    default 300000
    
config ZMK_IDLE_SLEEP_TIMEOUT
    default 1800000

config ZMK_USB
    default y

if SHIELD_C4_RIGHT || SHIELD_C4_LEFT

config ZMK_SPLIT
    default y

endif
```

## app/boards/shields/c4/Kconfig.shield
```kconfig
config SHIELD_C4_LEFT
    def_bool $(shields_list_contains,c4_left)
config SHIELD_C4_RIGHT
    def_bool $(shields_list_contains,c4_right)
```

## app/boards/shields/chocboard/Kconfig.defconfig
```kconfig
if SHIELD_CHOCBOARD_RIGHT

config ZMK_KEYBOARD_NAME
    default "chocBoard"

config ZMK_SPLIT_ROLE_CENTRAL
    default y

endif

config ZMK_IDLE_TIMEOUT
    default 300000
    
config ZMK_IDLE_SLEEP_TIMEOUT
    default 1800000

config ZMK_USB
    default y

if SHIELD_CHOCBOARD_RIGHT || SHIELD_CHOCBOARD_LEFT

config ZMK_SPLIT
    default y

endif
```

## app/boards/shields/chocboard/Kconfig.shield
```kconfig
config SHIELD_CHOCBOARD_LEFT
    def_bool $(shields_list_contains,chocboard_left)
config SHIELD_CHOCBOARD_RIGHT
    def_bool $(shields_list_contains,chocboard_right)
```
